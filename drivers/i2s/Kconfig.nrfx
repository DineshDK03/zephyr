## drivers/i2s/Kconfig.nrfx
```kconfig
# Copyright (c) 2019 Nordic Semiconductor ASA
# Copyright (c) 2021 Linumiz
# SPDX-License-Identifier: Apache-2.0

menuconfig I2S_NRFX
	bool "nRF I2S driver"
	default y
	depends on HAS_HW_NRF_I2S
	help
	  Enable I2S driver for nRF line of MCUs.

if I2S_NRFX

config NRFX_I2S_RX_BLOCK_COUNT
	int "RX queue length"
	default 4

config NRFX_I2S_TX_BLOCK_COUNT
	int "TX queue length"
	default 4

endif # I2S_NRFX
```

## drivers/sensor/grow_r502a/Kconfig
```kconfig
# GROW_R502A hzgrow Fingerprint sensor Configuration options

# Copyright (c) 2021 Linumiz
# SPDX-License-Identifier: Apache-2.0

menuconfig GROW_R502A
	bool "GROW_R502A Fingerprint Sensor"
	depends on SERIAL
	select RING_BUFFER
	help
	  Enable driver for GROW_R502A Fingerprint Sensor.
```

## dts/bindings/sensor/grow,grow_r502a.yaml
```yaml
# Copyright (c) 2021, Linumiz
# SPDX-License-Identifier: Apache-2.0

description: HZ-Grow GROW_R502A Fingerprint sensor.

compatible: "grow,grow_r502a"

include: uart-device.yaml
```
